## conf/layer.conf
```bitbake
# We have a conf and classes directory, add to BBPATH
BBPATH .= ":${LAYERDIR}"

# We have recipes-* directories, add to BBFILES
BBFILES += "${LAYERDIR}/recipes-*/*/*.bb \
            ${LAYERDIR}/recipes-*/*/*.bbappend"

BBFILE_COLLECTIONS += "meta-ds-dev"
BBFILE_PATTERN_meta-ds-dev = "^${LAYERDIR}/"
BBFILE_PRIORITY_meta-ds-dev = "6"

LAYERDEPENDS_meta-ds-dev = "core"
LAYERSERIES_COMPAT_meta-ds-dev = "scarthgap"
```
